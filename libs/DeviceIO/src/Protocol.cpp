//
// Protocol.cpp
//
// $Id: //poco/1.2/DeviceIO/src/Protocol.cpp#2 $
//
// Library: DeviceIO
// Package: Protocol
// Module:  Protocol
//
// Copyright (c) 2005-2006, Applied Informatics Software Engineering GmbH.
// and Contributors.
//
// Permission is hereby granted, free of charge, to any person or organization
// obtaining a copy of the software and accompanying documentation covered by
// this license (the "Software") to use, reproduce, display, distribute,
// execute, and transmit the Software, and to prepare derivative works of the
// Software, and to permit third-parties to whom the Software is furnished to
// do so, all subject to the following:
// 
// The copyright notices in the Software and this entire statement, including
// the above license grant, this restriction and the following disclaimer,
// must be included in all copies of the Software, in whole or in part, and
// all derivative works of the Software, unless such copies or derivative
// works are solely in the form of machine-executable object code generated by
// a source language processor.
// 
// THE SOFTWARE IS PROVIDED "AS IS", WITHOUT WARRANTY OF ANY KIND, EXPRESS OR
// IMPLIED, INCLUDING BUT NOT LIMITED TO THE WARRANTIES OF MERCHANTABILITY,
// FITNESS FOR A PARTICULAR PURPOSE, TITLE AND NON-INFRINGEMENT. IN NO EVENT
// SHALL THE COPYRIGHT HOLDERS OR ANYONE DISTRIBUTING THE SOFTWARE BE LIABLE
// FOR ANY DAMAGES OR OTHER LIABILITY, WHETHER IN CONTRACT, TORT OR OTHERWISE,
// ARISING FROM, OUT OF OR IN CONNECTION WITH THE SOFTWARE OR THE USE OR OTHER
// DEALINGS IN THE SOFTWARE.
//


#include "Poco/DeviceIO/Protocol.h"
#include "Poco/SharedPtr.h"
#include "Poco/Exception.h"
#include "Poco/Mutex.h"
#include "Poco/Exception.h"
#include "Poco/Format.h"


using Poco::SharedPtr;
using Poco::Mutex;
using Poco::format;
using Poco::CircularReferenceException;
using Poco::NotFoundException;
using Poco::NullPointerException;
using Poco::NotFoundException;
using Poco::IllegalStateException;


namespace Poco {
namespace DeviceIO {


Protocol::Protocol(const std::string& name, Channel* pChannel): 
	_name(name),
	_pChannel(pChannel),
	_pProtocols(new ProtocolVec()),
	_pBuffer(new ProtocolData()),
	_pParent(0),
	_established(false)
{
	_pProtocols->push_back(this);
}


Protocol::Protocol(const std::string& name): 
	_name(name),
	_pChannel(0),
	_pProtocols(0),
	_pBuffer(0),
	_pParent(0),
	_established(false)
{
}


Protocol::~Protocol()
{
	if (isRoot())
	{
		ProtocolVec& rProtocols = protocols();
		ProtocolVec::iterator it = rProtocols.begin();
		for (; it != rProtocols.end(); ) 
		{
			if (this != *it) 
			{
				delete *it;
				it = rProtocols.erase(it);
			}
			else ++it;
		}

		for (int i = _pChannel->referenceCount(); i > 0; --i)
			_pChannel->release();

		delete _pProtocols;
		delete _pBuffer;
	}
}


void Protocol::setChannel(Channel* pChannel)
{
	poco_check_ptr (pChannel);
	if (!_pParent) 
	{
		_pChannel = pChannel;
		if (!_pProtocols) 
		{
			_pProtocols = new ProtocolVec();
			_pProtocols->push_back(this);
		}
		if (!_pBuffer) 
			_pBuffer = new ProtocolData();
	}
	else _pParent->setChannel(pChannel);
}


int Protocol::send()
{
	int ret = channel().write(buffer());
	clear();
	return ret;
}


std::string& Protocol::receive(std::string& buf)
{
	channel().read(buffer());
	return buf = data();
}


int Protocol::read(char* pBuffer, int length)
{
	std::string str;
	receive(str);

	std::memset(pBuffer, 0, length);
	int len = str.size() > length ? length : static_cast<int>(str.size());
	std::memcpy(pBuffer, str.data(), len);

	return len;
}


int Protocol::write(const char* buf, int length, bool doSend)
{
	buffer().assign(buf, length);

	ProtocolVec& rProtocols = protocols();
	ProtocolVec::iterator it = rProtocols.begin();
	ProtocolVec::iterator itEnd = rProtocols.end();
	for (; it != itEnd; ++it) if (this == *it) break;
	for (; it != itEnd; ++it) (*it)->wrap();

	int ret = 0;
	if (doSend) ret = send();
	return ret ? ret : (int) buffer().size();
}


std::string& Protocol::data()
{
	ProtocolVec& rProtocols = protocols();
	ProtocolVec::reverse_iterator rIt = rProtocols.rbegin();
	ProtocolVec::reverse_iterator rItEnd = rProtocols.rend();
	for (; rIt != rItEnd; ++rIt) 
	{
		if (this == *rIt) return (*rIt)->unwrap();
		(*rIt)->unwrap();
	}

	throw IllegalStateException("Protocol not part of it's own chain.");
}


void Protocol::add(Protocol* pProtocol)
{
	if (0 == pProtocol) throw NullPointerException();
	if (this == pProtocol) throw CircularReferenceException();

	Mutex::ScopedLock lock(_mutex);

	ProtocolVec& rProtocols = protocols();
	ProtocolVec::iterator it = rProtocols.begin();
	ProtocolVec::iterator itEnd = rProtocols.end();
	for (; it != itEnd; ++it)
	{
		if (*it == pProtocol)
			throw CircularReferenceException();
		else if ((*it)->name() == pProtocol->name())
			throw InvalidArgumentException(format("A protocol named %s already exists.", pProtocol->name()));
	}

	if (pProtocol->_pParent) 
		pProtocol->detachImpl(false);
	pProtocol->_pChannel = 0;
	pProtocol->_pBuffer = 0;
	pProtocol->_pParent = this;
	pProtocol->_pProtocols = 0;
	protocols().push_back(pProtocol);
}


void Protocol::remove(const std::string& name)
{
	if (name == _name) throw InvalidAccessException();

	Mutex::ScopedLock lock(_mutex);

	ProtocolVec& rProtocols = protocols();
	ProtocolVec::iterator it = rProtocols.begin();
	ProtocolVec::iterator itEnd = rProtocols.end();
	ProtocolVec::iterator itPrev = it;
	for (; it != itEnd; ++it)
	{
		if (name == (*it)->name())
		{
			if (*it != this)
			{
				delete *it;
				it = rProtocols.erase(it);
				if (it != rProtocols.end() && it != rProtocols.begin())
					(*it)->_pParent = *itPrev;
				return;
			}
			else throw InvalidArgumentException("Can not remove self.");

			return;
		}
		itPrev = it;
	}

	throw NotFoundException(name);
}


void Protocol::detachImpl(bool destroy)
{
	if (_pParent) 
	{
		_mutex.lock();
		ProtocolVec& rProtocols = protocols();
		ProtocolVec::iterator it = rProtocols.begin();
		ProtocolVec::iterator itEnd = rProtocols.end();
		ProtocolVec::iterator itPrev = it;
		for (; it != itEnd; ++it) 
		{
			if (this == *it) 
			{
				it = rProtocols.erase(it);
				if (it != rProtocols.end() && it != rProtocols.begin())
					(*it)->_pParent = *itPrev;
				if (destroy) 
				{
					_mutex.unlock();
					delete this;
					return;
				}
			}
			itPrev = it;
		}
		_mutex.unlock();
	}
}


int Protocol::establish()
{
	int ret = 0;

	ProtocolVec& rProtocols = protocols();
	ProtocolVec::iterator it = rProtocols.begin();
	ProtocolVec::iterator itEnd = rProtocols.end();
	for (; it != itEnd; ++it) 
	{
		if (this != *it && !(*it)->isEstablished()) 
			ret += (*it)->establish();
	}

	return ret;
}


void Protocol::terminate()
{
	ProtocolVec& rProtocols = protocols();
	ProtocolVec::iterator it = rProtocols.begin();
	ProtocolVec::iterator itEnd = rProtocols.end();
	for (; it != itEnd; ++it) 
	{
		if (this != *it && (*it)->isEstablished()) 
		{
			(*it)->terminate();
			(*it)->_established = false;
		}
	}
}


void Protocol::setEstablished(bool established)
{
	ProtocolVec& rProtocols = protocols();
	ProtocolVec::iterator it = rProtocols.begin();
	ProtocolVec::iterator itEnd = rProtocols.end();
	for (; it != itEnd; ++it) 
		(*it)->_established = established;
}


} } // namespace Poco::DeviceIO
